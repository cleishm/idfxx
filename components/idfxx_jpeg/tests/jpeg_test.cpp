// SPDX-License-Identifier: Apache-2.0
// Copyright 2026 Chris Leishman

// Unit tests for idfxx_jpeg
// Uses ESP-IDF Unity test framework with compile-time static_asserts
//
// The test images and their golden hashes are generated by
// gen_jpeg_test_images.py (see jpeg_test_images.hpp).

#include "jpeg_test_images.hpp"

#include <idfxx/byte_source>
#include <idfxx/error>
#include <idfxx/image>
#include <idfxx/jpeg>
#include <unity.h>

#include <algorithm>
#include <cstddef>
#include <cstdint>
#include <initializer_list>
#include <optional>
#include <span>
#include <stdexcept>
#include <string_view>
#include <system_error>
#include <type_traits>
#include <utility>
#include <vector>

using namespace idfxx;
using idfxx::image::orientation;
using idfxx::image::rgb888;

namespace img = jpeg_test_images;

// =============================================================================
// Compile-time tests (static_assert)
// These verify correctness at compile time - if this file compiles, they pass.
// =============================================================================

static_assert(std::is_error_code_enum_v<jpeg::errc>);
static_assert(std::to_underlying(jpeg::errc::invalid_data) == 1);
static_assert(std::to_underlying(jpeg::errc::truncated) == 2);
static_assert(std::to_underlying(jpeg::errc::not_supported) == 3);
static_assert(std::to_underlying(jpeg::errc::too_large) == 4);

static_assert(!std::is_copy_constructible_v<jpeg::decoder>);
static_assert(!std::is_copy_assignable_v<jpeg::decoder>);
static_assert(std::is_nothrow_move_constructible_v<jpeg::decoder>);
static_assert(std::is_nothrow_move_assignable_v<jpeg::decoder>);
static_assert(std::same_as<decltype(jpeg::decoder::make(std::declval<memory_source&>())), result<jpeg::decoder>>);
static_assert(!std::is_default_constructible_v<jpeg::decoder>);

static_assert(std::same_as<decltype(jpeg::decoder::config{}.memory_limit), std::optional<size_t>>);

// =============================================================================
// Helpers
// =============================================================================

namespace {

uint32_t fnv1a(image::view<const rgb888> v) {
    uint32_t h = 0x811C9DC5u;
    for (size_t y = 0; y < v.height(); ++y) {
        for (const rgb888& p : v.row(y)) {
            for (uint8_t c : {p.r, p.g, p.b}) {
                h ^= c;
                h *= 0x01000193u;
            }
        }
    }
    return h;
}

template<size_t N>
std::span<const uint8_t> bytes(const uint8_t (&data)[N]) {
    return {data, N};
}

// Decodes a whole image at full size, and returns the hash of its pixels.
uint32_t decode_hash(std::span<const uint8_t> data) {
    memory_source src{data};
    auto dec = jpeg::decoder::make(src);
    TEST_ASSERT_TRUE(dec.has_value());
    image::buffer<> out(dec->output_width(), dec->output_height());
    auto r = dec->try_decode(out);
    TEST_ASSERT_TRUE(r.has_value());
    return fnv1a(out);
}

// Returns the error from reading the headers and decoding, or success.
result<void> try_decode_all(std::span<const uint8_t> data, jpeg::decoder::config cfg = {}) {
    memory_source src{data};
    auto dec = jpeg::decoder::make(src, cfg);
    if (!dec) {
        return error(dec.error());
    }
    image::buffer<> out(dec->output_width(), dec->output_height());
    return dec->try_decode(out);
}

// Decodes an image under a memory limit, into a view or row by row into a sink.
result<void> try_decode_limited(std::span<const uint8_t> data, size_t limit, bool to_sink) {
    memory_source src{data};
    auto dec = jpeg::decoder::make(src, {.memory_limit = limit});
    // The limit applies from the start of decoding, so the headers are read whatever it is.
    TEST_ASSERT_TRUE(dec.has_value());
    if (to_sink) {
        return dec->try_decode([](image::point, image::view<const rgb888>) -> result<void> { return {}; });
    }
    image::buffer<> out(dec->output_width(), dec->output_height());
    return dec->try_decode(out);
}

// Returns the smallest memory limit under which an image decodes. Every limit below it must fail with too_large,
// wherever the decoder is when it reaches the limit; that is checked every 256 bytes on the way up.
size_t smallest_limit(std::span<const uint8_t> data, bool to_sink = false) {
    constexpr size_t step = 256;
    size_t limit = 0;
    while (true) {
        auto r = try_decode_limited(data, limit, to_sink);
        if (r) {
            break;
        }
        TEST_ASSERT_TRUE_MESSAGE(r.error() == jpeg::errc::too_large, "decode under a memory limit not too_large");
        TEST_ASSERT_TRUE_MESSAGE(limit < 1024 * 1024, "no memory limit up to 1 MB decodes the image");
        limit += step;
    }
    if (limit == 0) {
        return 0;
    }
    // Decoding fails at limit - step and succeeds at limit; narrow it down in between.
    size_t fails = limit - step;
    size_t decodes = limit;
    while (decodes - fails > 1) {
        const size_t mid = fails + (decodes - fails) / 2;
        auto r = try_decode_limited(data, mid, to_sink);
        if (r) {
            decodes = mid;
        } else {
            TEST_ASSERT_TRUE_MESSAGE(r.error() == jpeg::errc::too_large, "decode under a memory limit not too_large");
            fails = mid;
        }
    }
    return decodes;
}

// A source that delivers the first `limit` bytes of some data, then fails.
class failing_source {
public:
    failing_source(std::span<const uint8_t> data, size_t limit)
        : _src(data.first(std::min(limit, data.size()))) {}

    result<size_t> try_read(std::span<uint8_t> buf) {
        if (_src.remaining() == 0) {
            return error(std::make_error_code(std::errc::io_error));
        }
        return _src.try_read(buf);
    }

private:
    memory_source _src;
};

static_assert(byte_source<failing_source>);

// A source that returns at most `chunk` bytes per read, counting the total.
class chunked_source {
public:
    chunked_source(std::span<const uint8_t> data, size_t chunk)
        : _src(data)
        , _chunk(chunk) {}

    result<size_t> try_read(std::span<uint8_t> buf) {
        auto n = _src.try_read(buf.first(std::min(buf.size(), _chunk)));
        if (n) {
            total += *n;
        }
        return n;
    }

    size_t total = 0;

private:
    memory_source _src;
    size_t _chunk;
};

// Returns the offset of the first marker of the given type, walking the
// segments from the start of the stream.
size_t marker_offset(std::span<const uint8_t> data, uint8_t marker) {
    size_t i = 2;
    while (i + 4 <= data.size() && data[i] == 0xFF) {
        if (data[i + 1] == marker) {
            return i;
        }
        i += 2 + ((data[i + 2] << 8) | data[i + 3]);
    }
    TEST_FAIL_MESSAGE("marker not found");
    return 0;
}

// --- EXIF segment builders ---------------------------------------------------

void put16(std::vector<uint8_t>& out, bool le, uint16_t v) {
    if (le) {
        out.push_back(v & 0xFF);
        out.push_back(v >> 8);
    } else {
        out.push_back(v >> 8);
        out.push_back(v & 0xFF);
    }
}

void put32(std::vector<uint8_t>& out, bool le, uint32_t v) {
    if (le) {
        put16(out, le, v & 0xFFFF);
        put16(out, le, v >> 16);
    } else {
        put16(out, le, v >> 16);
        put16(out, le, v & 0xFFFF);
    }
}

struct exif_options {
    bool little_endian = true;
    uint16_t value = 1;
    bool include_orientation = true;
    uint16_t type = 3;    // SHORT
    uint32_t count = 1;
    uint32_t ifd_offset = 8;
    size_t truncate_to = SIZE_MAX;
};

// Builds an APP1 payload: "Exif\0\0" and a TIFF structure whose IFD0 holds a
// Make tag and (optionally) an Orientation tag.
std::vector<uint8_t> exif_payload(const exif_options& o) {
    std::vector<uint8_t> tiff;
    const bool le = o.little_endian;
    tiff.push_back(le ? 'I' : 'M');
    tiff.push_back(le ? 'I' : 'M');
    put16(tiff, le, 42);
    put32(tiff, le, o.ifd_offset);
    put16(tiff, le, o.include_orientation ? 2 : 1);
    // Make (0x010F), ASCII, 4 bytes inline: "abc\0".
    put16(tiff, le, 0x010F);
    put16(tiff, le, 2);
    put32(tiff, le, 4);
    for (uint8_t c : {'a', 'b', 'c', '\0'}) {
        tiff.push_back(c);
    }
    if (o.include_orientation) {
        put16(tiff, le, 0x0112);
        put16(tiff, le, o.type);
        put32(tiff, le, o.count);
        put16(tiff, le, o.value);
        put16(tiff, le, 0);
    }
    put32(tiff, le, 0); // no next IFD
    if (o.truncate_to < tiff.size()) {
        tiff.resize(o.truncate_to);
    }

    std::vector<uint8_t> payload = {'E', 'x', 'i', 'f', 0, 0};
    payload.insert(payload.end(), tiff.begin(), tiff.end());
    return payload;
}

std::vector<uint8_t> app1(const std::vector<uint8_t>& payload) {
    std::vector<uint8_t> seg = {0xFF, 0xE1};
    put16(seg, false, static_cast<uint16_t>(payload.size() + 2));
    seg.insert(seg.end(), payload.begin(), payload.end());
    return seg;
}

// Returns the tiny test JPEG with the given segments inserted after its SOI.
std::vector<uint8_t> with_segments(std::initializer_list<std::vector<uint8_t>> segments) {
    std::span<const uint8_t> base = bytes(img::tiny);
    std::vector<uint8_t> out(base.begin(), base.begin() + 2);
    for (const auto& seg : segments) {
        out.insert(out.end(), seg.begin(), seg.end());
    }
    out.insert(out.end(), base.begin() + 2, base.end());
    return out;
}

// Returns the offset just past the first segment of the given marker type.
size_t segment_end(std::span<const uint8_t> data, uint8_t marker) {
    const size_t at = marker_offset(data, marker);
    return at + 2 + ((data[at + 2] << 8) | data[at + 3]);
}

// Returns the orientation from an image's headers, checking that the image still decodes: each APP1 segment must be
// read to its end and no further.
orientation orientation_of(const std::vector<uint8_t>& data) {
    memory_source src{data};
    auto dec = jpeg::decoder::make(src);
    TEST_ASSERT_TRUE(dec.has_value());
    image::buffer<> out(dec->output_width(), dec->output_height());
    TEST_ASSERT_TRUE(dec->try_decode(out).has_value());
    return dec->info().orientation;
}

} // namespace

// =============================================================================
// Error category
// =============================================================================

TEST_CASE("jpeg errc converts to error_code in the jpeg category", "[idfxx][jpeg]") {
    std::error_code ec = jpeg::errc::truncated;
    TEST_ASSERT_TRUE(ec.category() == jpeg::jpeg_category());
    TEST_ASSERT_EQUAL_INT(2, ec.value());
    TEST_ASSERT_EQUAL_STRING("jpeg::Error", ec.category().name());
    TEST_ASSERT_EQUAL_STRING("Not a JPEG, or corrupt", std::error_code(jpeg::errc::invalid_data).message().c_str());
    TEST_ASSERT_EQUAL_STRING(
        "JPEG data ended before the end of the image", std::error_code(jpeg::errc::truncated).message().c_str()
    );
    TEST_ASSERT_EQUAL_STRING(
        "JPEG uses a feature the decoder does not support", std::error_code(jpeg::errc::not_supported).message().c_str()
    );
    TEST_ASSERT_EQUAL_STRING(
        "JPEG needs more working memory than the configured limit",
        std::error_code(jpeg::errc::too_large).message().c_str()
    );
}

// =============================================================================
// Headers
// =============================================================================

TEST_CASE("jpeg decoder reads image info from the headers", "[idfxx][jpeg]") {
    memory_source src{bytes(img::baseline_420)};
    auto dec = jpeg::decoder::make(src);
    TEST_ASSERT_TRUE(dec.has_value());
    TEST_ASSERT_EQUAL_UINT32(img::baseline_420_width, dec->info().width);
    TEST_ASSERT_EQUAL_UINT32(img::baseline_420_height, dec->info().height);
    TEST_ASSERT_TRUE(dec->info().orientation == orientation::identity);
    TEST_ASSERT_FALSE(dec->info().progressive);
    TEST_ASSERT_EQUAL_UINT32(img::baseline_420_width, dec->output_width());
    TEST_ASSERT_EQUAL_UINT32(img::baseline_420_height, dec->output_height());

    memory_source psrc{bytes(img::progressive)};
    auto pdec = jpeg::decoder::make(psrc);
    TEST_ASSERT_TRUE(pdec.has_value());
    TEST_ASSERT_TRUE(pdec->info().progressive);
}

TEST_CASE("jpeg decoder reads only the headers on construction", "[idfxx][jpeg]") {
    std::span<const uint8_t> data = bytes(img::baseline_420);
    const size_t sos = marker_offset(data, 0xDA);
    chunked_source src(data, 16);
    auto dec = jpeg::decoder::make(src);
    TEST_ASSERT_TRUE(dec.has_value());
    TEST_ASSERT_TRUE(src.total > sos);
    TEST_ASSERT_TRUE(src.total < sos + 32);

    // Short reads are fine for decoding too.
    image::buffer<> out(dec->output_width(), dec->output_height());
    TEST_ASSERT_TRUE(dec->try_decode(out).has_value());
    TEST_ASSERT_EQUAL_HEX32(img::baseline_420_hash, fnv1a(out));
    TEST_ASSERT_EQUAL_UINT32(data.size(), src.total);
}

TEST_CASE("jpeg decoder rejects CMYK images as not supported", "[idfxx][jpeg]") {
    memory_source src{bytes(img::cmyk)};
    auto dec = jpeg::decoder::make(src);
    TEST_ASSERT_FALSE(dec.has_value());
    TEST_ASSERT_TRUE(dec.error() == jpeg::errc::not_supported);
}

TEST_CASE("jpeg decoder rejects 12-bit images as not supported", "[idfxx][jpeg]") {
    memory_source src{bytes(img::precision_12)};
    auto dec = jpeg::decoder::make(src);
    TEST_ASSERT_FALSE(dec.has_value());
    TEST_ASSERT_TRUE(dec.error() == jpeg::errc::not_supported);
}

TEST_CASE("jpeg decoder rejects lossless images as not supported", "[idfxx][jpeg]") {
    memory_source src{bytes(img::lossless)};
    auto dec = jpeg::decoder::make(src);
    TEST_ASSERT_FALSE(dec.has_value());
    TEST_ASSERT_TRUE(dec.error() == jpeg::errc::not_supported);
}

TEST_CASE("jpeg decoder rejects data that is not a JPEG", "[idfxx][jpeg]") {
    std::vector<uint8_t> garbage(64, 0x55);
    memory_source src{garbage};
    auto dec = jpeg::decoder::make(src);
    TEST_ASSERT_FALSE(dec.has_value());
    TEST_ASSERT_TRUE(dec.error() == jpeg::errc::invalid_data);

    static const uint8_t png_signature[] = {0x89, 'P', 'N', 'G', 0x0D, 0x0A, 0x1A, 0x0A, 0, 0, 0, 0x0D};
    memory_source psrc{png_signature};
    auto pdec = jpeg::decoder::make(psrc);
    TEST_ASSERT_FALSE(pdec.has_value());
    TEST_ASSERT_TRUE(pdec.error() == jpeg::errc::invalid_data);
}

TEST_CASE("jpeg decoder reports an empty stream as truncated", "[idfxx][jpeg]") {
    memory_source src{std::span<const uint8_t>{}};
    auto dec = jpeg::decoder::make(src);
    TEST_ASSERT_FALSE(dec.has_value());
    TEST_ASSERT_TRUE(dec.error() == jpeg::errc::truncated);
}

// =============================================================================
// Full-size decoding
// =============================================================================

TEST_CASE("jpeg decodes baseline 4:2:0 to the reference pixels", "[idfxx][jpeg]") {
    TEST_ASSERT_EQUAL_HEX32(img::baseline_420_hash, decode_hash(bytes(img::baseline_420)));
}

TEST_CASE("jpeg decodes baseline 4:4:4 to the reference pixels", "[idfxx][jpeg]") {
    TEST_ASSERT_EQUAL_HEX32(img::baseline_444_hash, decode_hash(bytes(img::baseline_444)));
}

TEST_CASE("jpeg decodes grayscale to RGB with equal channels", "[idfxx][jpeg]") {
    memory_source src{bytes(img::grayscale)};
    auto dec = jpeg::decoder::make(src);
    TEST_ASSERT_TRUE(dec.has_value());
    image::buffer<> out(dec->output_width(), dec->output_height());
    TEST_ASSERT_TRUE(dec->try_decode(out).has_value());
    TEST_ASSERT_EQUAL_HEX32(img::grayscale_hash, fnv1a(out));
    for (size_t y = 0; y < out.height(); ++y) {
        for (const rgb888& p : out.row(y)) {
            TEST_ASSERT_EQUAL_UINT8(p.r, p.g);
            TEST_ASSERT_EQUAL_UINT8(p.r, p.b);
        }
    }
}

TEST_CASE("jpeg decodes progressive to the reference pixels", "[idfxx][jpeg]") {
    TEST_ASSERT_EQUAL_HEX32(img::progressive_hash, decode_hash(bytes(img::progressive)));
}

TEST_CASE("jpeg decodes restart intervals to the reference pixels", "[idfxx][jpeg]") {
    TEST_ASSERT_EQUAL_HEX32(img::restart_hash, decode_hash(bytes(img::restart)));
}

TEST_CASE("jpeg decodes arithmetic coding to the reference pixels", "[idfxx][jpeg]") {
    // The arithmetic-coded image has the same coefficients as baseline_420.
    TEST_ASSERT_EQUAL_HEX32(img::baseline_420_hash, decode_hash(bytes(img::arithmetic)));
}

// =============================================================================
// Scaling
// =============================================================================

TEST_CASE("jpeg decodes at every scale M/8 to the reference pixels", "[idfxx][jpeg]") {
    for (size_t m = 1; m <= 8; ++m) {
        const img::scaled_output& expected = img::scaled_outputs[m - 1];
        memory_source src{bytes(img::scaled)};
        auto dec = jpeg::decoder::make(src);
        TEST_ASSERT_TRUE(dec.has_value());
        dec->scale_to_cover(expected.width, expected.height);
        TEST_ASSERT_EQUAL_UINT32(expected.width, dec->output_width());
        TEST_ASSERT_EQUAL_UINT32(expected.height, dec->output_height());
        image::buffer<> out(dec->output_width(), dec->output_height());
        TEST_ASSERT_TRUE(dec->try_decode(out).has_value());
        TEST_ASSERT_EQUAL_HEX32_MESSAGE(expected.hash, fnv1a(out), "scaled output differs");
    }
}

TEST_CASE("jpeg scale_to_cover picks the smallest covering scale", "[idfxx][jpeg]") {
    memory_source src{bytes(img::scaled)};
    auto dec = jpeg::decoder::make(src);
    TEST_ASSERT_TRUE(dec.has_value());
    const auto& s = img::scaled_outputs;

    // Exactly the 3/8 size is covered by 3/8; one more pixel in either
    // direction needs 4/8.
    dec->scale_to_cover(s[2].width, s[2].height);
    TEST_ASSERT_EQUAL_UINT32(s[2].width, dec->output_width());
    TEST_ASSERT_EQUAL_UINT32(s[2].height, dec->output_height());
    dec->scale_to_cover(s[2].width + 1, s[2].height);
    TEST_ASSERT_EQUAL_UINT32(s[3].width, dec->output_width());
    TEST_ASSERT_EQUAL_UINT32(s[3].height, dec->output_height());
    dec->scale_to_cover(s[2].width, s[2].height + 1);
    TEST_ASSERT_EQUAL_UINT32(s[3].width, dec->output_width());

    // One dimension alone can force a larger scale.
    dec->scale_to_cover(1, s[6].height);
    TEST_ASSERT_EQUAL_UINT32(s[6].width, dec->output_width());

    // A target of nothing is covered by the smallest scale.
    dec->scale_to_cover(0, 0);
    TEST_ASSERT_EQUAL_UINT32(s[0].width, dec->output_width());
    TEST_ASSERT_EQUAL_UINT32(s[0].height, dec->output_height());

    // A target larger than the image gives full size, not an upscale.
    dec->scale_to_cover(1000, 1000);
    TEST_ASSERT_EQUAL_UINT32(img::scaled_outputs[7].width, dec->output_width());
    TEST_ASSERT_EQUAL_UINT32(img::scaled_outputs[7].height, dec->output_height());
    dec->scale_to_cover(s[7].width + 1, 1);
    TEST_ASSERT_EQUAL_UINT32(s[7].width, dec->output_width());

    // The last call decides.
    dec->scale_to_cover(s[4].width, s[4].height);
    image::buffer<> out(dec->output_width(), dec->output_height());
    TEST_ASSERT_TRUE(dec->try_decode(out).has_value());
    TEST_ASSERT_EQUAL_HEX32(s[4].hash, fnv1a(out));
}

// =============================================================================
// Decoding into a view
// =============================================================================

TEST_CASE("jpeg decodes into a strided view without touching other pixels", "[idfxx][jpeg]") {
    constexpr rgb888 sentinel{1, 2, 3};
    const size_t w = img::baseline_420_width;
    const size_t h = img::baseline_420_height;
    image::buffer<> canvas(w + 5, h + 2, sentinel);

    memory_source src{bytes(img::baseline_420)};
    auto dec = jpeg::decoder::make(src);
    TEST_ASSERT_TRUE(dec.has_value());
    auto region = canvas.subview(2, 1, w, h);
    TEST_ASSERT_TRUE(region.stride() > region.width());
    TEST_ASSERT_TRUE(dec->try_decode(region).has_value());
    TEST_ASSERT_EQUAL_HEX32(img::baseline_420_hash, fnv1a(region));

    for (size_t y = 0; y < canvas.height(); ++y) {
        for (size_t x = 0; x < canvas.width(); ++x) {
            const bool inside = x >= 2 && x < 2 + w && y >= 1 && y < 1 + h;
            if (!inside) {
                TEST_ASSERT_TRUE((canvas[x, y] == sentinel));
            }
        }
    }
}

TEST_CASE("jpeg rejects a view of the wrong size", "[idfxx][jpeg]") {
    memory_source src{bytes(img::baseline_420)};
    auto dec = jpeg::decoder::make(src);
    TEST_ASSERT_TRUE(dec.has_value());

    image::buffer<> narrow(dec->output_width() - 1, dec->output_height());
    auto r = dec->try_decode(narrow);
    TEST_ASSERT_FALSE(r.has_value());
    TEST_ASSERT_TRUE(r.error() == idfxx::errc::invalid_size);

    image::buffer<> tall(dec->output_width(), dec->output_height() + 1);
    r = dec->try_decode(tall);
    TEST_ASSERT_FALSE(r.has_value());
    TEST_ASSERT_TRUE(r.error() == idfxx::errc::invalid_size);

    // A size mismatch does not use up the decode.
    image::buffer<> out(dec->output_width(), dec->output_height());
    TEST_ASSERT_TRUE(dec->try_decode(out).has_value());
    TEST_ASSERT_EQUAL_HEX32(img::baseline_420_hash, fnv1a(out));
}

TEST_CASE("jpeg rejects a view of the full size after scaling", "[idfxx][jpeg]") {
    memory_source src{bytes(img::scaled)};
    auto dec = jpeg::decoder::make(src);
    TEST_ASSERT_TRUE(dec.has_value());
    dec->scale_to_cover(img::scaled_outputs[3].width, img::scaled_outputs[3].height);
    image::buffer<> full(dec->info().width, dec->info().height);
    auto r = dec->try_decode(full);
    TEST_ASSERT_FALSE(r.has_value());
    TEST_ASSERT_TRUE(r.error() == idfxx::errc::invalid_size);
}

TEST_CASE("jpeg decodes only once", "[idfxx][jpeg]") {
    memory_source src{bytes(img::baseline_420)};
    auto dec = jpeg::decoder::make(src);
    TEST_ASSERT_TRUE(dec.has_value());
    image::buffer<> out(dec->output_width(), dec->output_height());
    TEST_ASSERT_TRUE(dec->try_decode(out).has_value());

    auto r = dec->try_decode(out);
    TEST_ASSERT_FALSE(r.has_value());
    TEST_ASSERT_TRUE(r.error() == idfxx::errc::invalid_state);

    auto sink = [](image::point, image::view<const rgb888>) -> result<void> { return {}; };
    r = dec->try_decode(sink);
    TEST_ASSERT_FALSE(r.has_value());
    TEST_ASSERT_TRUE(r.error() == idfxx::errc::invalid_state);
}

TEST_CASE("jpeg decoder can be moved", "[idfxx][jpeg]") {
    memory_source src{bytes(img::baseline_420)};
    auto made = jpeg::decoder::make(src);
    TEST_ASSERT_TRUE(made.has_value());
    jpeg::decoder dec = std::move(*made);

    memory_source other_src{bytes(img::grayscale)};
    auto other = jpeg::decoder::make(other_src);
    TEST_ASSERT_TRUE(other.has_value());
    dec = std::move(*other);
    TEST_ASSERT_EQUAL_UINT32(img::grayscale_width, dec.info().width);

    image::buffer<> out(dec.output_width(), dec.output_height());
    TEST_ASSERT_TRUE(dec.try_decode(out).has_value());
    TEST_ASSERT_EQUAL_HEX32(img::grayscale_hash, fnv1a(out));
}

// =============================================================================
// Decoding into a sink
// =============================================================================

TEST_CASE("jpeg delivers rows to a sink in order", "[idfxx][jpeg]") {
    memory_source src{bytes(img::scaled)};
    auto dec = jpeg::decoder::make(src);
    TEST_ASSERT_TRUE(dec.has_value());
    dec->scale_to_cover(img::scaled_outputs[5].width, img::scaled_outputs[5].height);
    const size_t w = dec->output_width();
    const size_t h = dec->output_height();

    image::buffer<> out(w, h);
    size_t next_row = 0;
    bool shape_ok = true;
    auto sink = [&](image::point at, image::view<const rgb888> row) -> result<void> {
        if (at.x != 0 || at.y != next_row || row.width() != w || row.height() != 1) {
            shape_ok = false;
        }
        std::copy(row.row(0).begin(), row.row(0).end(), out.row(at.y).begin());
        ++next_row;
        return {};
    };
    static_assert(image::sink<decltype(sink)>);
    TEST_ASSERT_TRUE(dec->try_decode(sink).has_value());
    TEST_ASSERT_TRUE(shape_ok);
    TEST_ASSERT_EQUAL_UINT32(h, next_row);
    TEST_ASSERT_EQUAL_HEX32(img::scaled_outputs[5].hash, fnv1a(out));
}

TEST_CASE("jpeg returns the error a sink returns", "[idfxx][jpeg]") {
    memory_source src{bytes(img::baseline_420)};
    auto dec = jpeg::decoder::make(src);
    TEST_ASSERT_TRUE(dec.has_value());

    const std::error_code stop = std::make_error_code(std::errc::operation_canceled);
    size_t calls = 0;
    auto r = dec->try_decode([&](image::point at, image::view<const rgb888>) -> result<void> {
        ++calls;
        if (at.y == 5) {
            return error(stop);
        }
        return {};
    });
    TEST_ASSERT_FALSE(r.has_value());
    TEST_ASSERT_TRUE(r.error() == stop);
    TEST_ASSERT_EQUAL_UINT32(6, calls);

    // The decoder is spent after a stopped decode.
    image::buffer<> out(dec->output_width(), dec->output_height());
    r = dec->try_decode(out);
    TEST_ASSERT_FALSE(r.has_value());
    TEST_ASSERT_TRUE(r.error() == idfxx::errc::invalid_state);
}

// =============================================================================
// Source errors and damaged data
// =============================================================================

TEST_CASE("jpeg returns a byte source error unchanged", "[idfxx][jpeg]") {
    std::span<const uint8_t> data = bytes(img::baseline_420);
    const std::error_code io = std::make_error_code(std::errc::io_error);

    // Failing within the headers fails construction.
    failing_source header_src(data, 100);
    auto dec = jpeg::decoder::make(header_src);
    TEST_ASSERT_FALSE(dec.has_value());
    TEST_ASSERT_TRUE(dec.error() == io);

    // Failing within the image data fails the decode.
    failing_source data_src(data, marker_offset(data, 0xDA) + 100);
    auto dec2 = jpeg::decoder::make(data_src);
    TEST_ASSERT_TRUE(dec2.has_value());
    image::buffer<> out(dec2->output_width(), dec2->output_height());
    auto r = dec2->try_decode(out);
    TEST_ASSERT_FALSE(r.has_value());
    TEST_ASSERT_TRUE(r.error() == io);

    // Failing just before the end-of-image marker is still reported.
    failing_source tail_src(data, data.size() - 2);
    auto dec3 = jpeg::decoder::make(tail_src);
    TEST_ASSERT_TRUE(dec3.has_value());
    r = dec3->try_decode(out);
    TEST_ASSERT_FALSE(r.has_value());
    TEST_ASSERT_TRUE(r.error() == io);
}

TEST_CASE("jpeg reports a cut-off stream as truncated", "[idfxx][jpeg]") {
    std::span<const uint8_t> data = bytes(img::baseline_420);
    const size_t sos = marker_offset(data, 0xDA);
    const size_t cuts[] = {1, 2, 20, sos / 2, sos, sos + 20, data.size() / 2, data.size() - 3, data.size() - 2,
                           data.size() - 1};
    for (size_t cut : cuts) {
        auto r = try_decode_all(data.first(cut));
        TEST_ASSERT_FALSE_MESSAGE(r.has_value(), "cut-off stream decoded");
        TEST_ASSERT_TRUE_MESSAGE(r.error() == jpeg::errc::truncated, "cut-off stream not reported as truncated");
    }

    // The progressive image is cut within its later scans.
    std::span<const uint8_t> pdata = bytes(img::progressive);
    auto r = try_decode_all(pdata.first(pdata.size() - 50));
    TEST_ASSERT_FALSE(r.has_value());
    TEST_ASSERT_TRUE(r.error() == jpeg::errc::truncated);
}

TEST_CASE("jpeg reports corrupt image data as invalid", "[idfxx][jpeg]") {
    std::span<const uint8_t> data = bytes(img::baseline_420);
    std::vector<uint8_t> corrupt(data.begin(), data.end());
    // A restart marker in the middle of a stream that declares no restart
    // interval.
    const size_t at = (marker_offset(data, 0xDA) + data.size()) / 2;
    corrupt[at] = 0xFF;
    corrupt[at + 1] = 0xD3;
    auto r = try_decode_all(corrupt);
    TEST_ASSERT_FALSE(r.has_value());
    TEST_ASSERT_TRUE(r.error() == jpeg::errc::invalid_data);

    // A corrupt header: a quantization table with an invalid index.
    std::vector<uint8_t> bad_header(data.begin(), data.end());
    const size_t dqt = marker_offset(data, 0xDB);
    bad_header[dqt + 4] = 0x0F;
    r = try_decode_all(bad_header);
    TEST_ASSERT_FALSE(r.has_value());
    TEST_ASSERT_TRUE(r.error() == jpeg::errc::invalid_data);
}

// =============================================================================
// Tolerated warnings
// =============================================================================

TEST_CASE("jpeg skips stray bytes between segments", "[idfxx][jpeg]") {
    std::span<const uint8_t> data = bytes(img::baseline_420);
    std::vector<uint8_t> stray(data.begin(), data.end());
    const std::vector<uint8_t> garbage = {0x12, 0x34, 0x56};
    stray.insert(stray.begin() + segment_end(data, 0xE0), garbage.begin(), garbage.end());
    TEST_ASSERT_EQUAL_HEX32(img::baseline_420_hash, decode_hash(stray));
}

TEST_CASE("jpeg accepts a JFIF version other than 1.x", "[idfxx][jpeg]") {
    std::span<const uint8_t> data = bytes(img::baseline_420);
    std::vector<uint8_t> v2(data.begin(), data.end());
    // The version follows the segment marker, its length and "JFIF\0".
    const size_t version = marker_offset(data, 0xE0) + 2 + 2 + 5;
    TEST_ASSERT_EQUAL_UINT8(1, v2[version]);
    v2[version] = 2;
    TEST_ASSERT_EQUAL_HEX32(img::baseline_420_hash, decode_hash(v2));
}

TEST_CASE("jpeg accepts an unrecognised Adobe color transform", "[idfxx][jpeg]") {
    std::span<const uint8_t> data = bytes(img::baseline_420);
    // Without a JFIF segment, the Adobe transform decides the color space; an
    // unknown transform is taken to be YCbCr.
    std::vector<uint8_t> adobe(data.begin(), data.begin() + 2);
    const std::vector<uint8_t> app14 = {
        0xFF, 0xEE, 0x00, 0x0E, 'A', 'd', 'o', 'b', 'e', 0x00, 0x64, 0x00, 0x00, 0x00, 0x00, 0x07
    };
    adobe.insert(adobe.end(), app14.begin(), app14.end());
    adobe.insert(adobe.end(), data.begin() + segment_end(data, 0xE0), data.end());

    memory_source src{adobe};
    auto dec = jpeg::decoder::make(src);
    TEST_ASSERT_TRUE(dec.has_value());
    TEST_ASSERT_EQUAL_UINT32(img::baseline_420_width, dec->output_width());
    TEST_ASSERT_EQUAL_UINT32(img::baseline_420_height, dec->output_height());
    TEST_ASSERT_EQUAL_HEX32(img::baseline_420_hash, decode_hash(adobe));
}

// =============================================================================
// Memory limit
// =============================================================================

TEST_CASE("jpeg decodes a tall progressive image to the reference pixels", "[idfxx][jpeg]") {
    TEST_ASSERT_EQUAL_HEX32(img::progressive_tall_hash, decode_hash(bytes(img::progressive_tall)));
}

TEST_CASE("jpeg memory_limit rejects a progressive image as too large", "[idfxx][jpeg]") {
    memory_source src{bytes(img::progressive_tall)};
    auto dec = jpeg::decoder::make(src, {.memory_limit = 1024});
    TEST_ASSERT_TRUE(dec.has_value());
    image::buffer<> out(dec->output_width(), dec->output_height());
    auto r = dec->try_decode(out);
    TEST_ASSERT_FALSE(r.has_value());
    TEST_ASSERT_TRUE(r.error() == jpeg::errc::too_large);

    // The limit applies at any output scale.
    memory_source ssrc{bytes(img::progressive_tall)};
    auto sdec = jpeg::decoder::make(ssrc, {.memory_limit = 1024});
    TEST_ASSERT_TRUE(sdec.has_value());
    sdec->scale_to_cover(1, 1);
    image::buffer<> small(sdec->output_width(), sdec->output_height());
    r = sdec->try_decode(small);
    TEST_ASSERT_FALSE(r.has_value());
    TEST_ASSERT_TRUE(r.error() == jpeg::errc::too_large);

    // A limit of zero is the smallest limit, not "no limit".
    r = try_decode_all(bytes(img::progressive_tall), {.memory_limit = 0});
    TEST_ASSERT_FALSE(r.has_value());
    TEST_ASSERT_TRUE(r.error() == jpeg::errc::too_large);

    // A generous limit decodes normally.
    TEST_ASSERT_TRUE(try_decode_all(bytes(img::progressive_tall), {.memory_limit = 1024 * 1024}).has_value());
}

TEST_CASE("jpeg memory_limit rejects a baseline image as too large", "[idfxx][jpeg]") {
    // The limit applies from the start of decoding, so the headers are read whatever it is.
    memory_source src{bytes(img::baseline_420)};
    auto dec = jpeg::decoder::make(src, {.memory_limit = 1024});
    TEST_ASSERT_TRUE(dec.has_value());
    image::buffer<> out(dec->output_width(), dec->output_height());
    auto r = dec->try_decode(out);
    TEST_ASSERT_FALSE(r.has_value());
    TEST_ASSERT_TRUE(r.error() == jpeg::errc::too_large);

    // A limit of zero is honored too.
    memory_source zsrc{bytes(img::baseline_420)};
    auto zdec = jpeg::decoder::make(zsrc, {.memory_limit = 0});
    TEST_ASSERT_TRUE(zdec.has_value());
    r = zdec->try_decode(out);
    TEST_ASSERT_FALSE(r.has_value());
    TEST_ASSERT_TRUE(r.error() == jpeg::errc::too_large);
}

TEST_CASE("jpeg memory_limit fails cleanly wherever decoding reaches it", "[idfxx][jpeg]") {
    struct limited_case {
        std::span<const uint8_t> data;
        uint32_t hash;
    };
    const limited_case cases[] = {
        {bytes(img::baseline_420), img::baseline_420_hash},
        {bytes(img::progressive), img::progressive_hash},
        {bytes(img::progressive_tall), img::progressive_tall_hash},
    };
    for (const limited_case& c : cases) {
        // Every smaller limit fails with too_large; this one is enough to decode the image.
        const size_t needed = smallest_limit(c.data);
        memory_source src{c.data};
        auto dec = jpeg::decoder::make(src, {.memory_limit = needed});
        TEST_ASSERT_TRUE(dec.has_value());
        image::buffer<> out(dec->output_width(), dec->output_height());
        TEST_ASSERT_TRUE(dec->try_decode(out).has_value());
        TEST_ASSERT_EQUAL_HEX32(c.hash, fnv1a(out));
    }
}

TEST_CASE("jpeg memory_limit counts the coefficients of a short progressive image", "[idfxx][jpeg]") {
    // progressive is the same 37x23 4:2:0 image as baseline_420, only two MCU rows high. A limit that just admits the
    // baseline decode leaves no room for the progressive image's coefficient buffer.
    const size_t baseline_needed = smallest_limit(bytes(img::baseline_420));
    auto r = try_decode_all(bytes(img::progressive), {.memory_limit = baseline_needed});
    TEST_ASSERT_FALSE(r.has_value());
    TEST_ASSERT_TRUE(r.error() == jpeg::errc::too_large);
}

TEST_CASE("jpeg memory_limit applies to decoding into a sink", "[idfxx][jpeg]") {
    memory_source src{bytes(img::baseline_420)};
    auto dec = jpeg::decoder::make(src, {.memory_limit = 1024});
    TEST_ASSERT_TRUE(dec.has_value());
    size_t rows = 0;
    auto r = dec->try_decode([&](image::point, image::view<const rgb888>) -> result<void> {
        ++rows;
        return {};
    });
    TEST_ASSERT_FALSE(r.has_value());
    TEST_ASSERT_TRUE(r.error() == jpeg::errc::too_large);
    TEST_ASSERT_EQUAL_UINT32(0, rows);

    // The sink's row buffer counts towards the limit too.
    const size_t view_needed = smallest_limit(bytes(img::baseline_420));
    const size_t sink_needed = smallest_limit(bytes(img::baseline_420), true);
    TEST_ASSERT_TRUE(sink_needed >= view_needed + img::baseline_420_width * sizeof(rgb888));
}

// =============================================================================
// EXIF orientation
// =============================================================================

TEST_CASE("jpeg reads the EXIF orientation in either byte order", "[idfxx][jpeg]") {
    for (bool le : {true, false}) {
        for (uint16_t v = 1; v <= 8; ++v) {
            auto data = with_segments({app1(exif_payload({.little_endian = le, .value = v}))});
            TEST_ASSERT_EQUAL_UINT8(v, std::to_underlying(orientation_of(data)));
        }
    }
}

TEST_CASE("jpeg EXIF orientation is identity when absent", "[idfxx][jpeg]") {
    TEST_ASSERT_TRUE(orientation_of(with_segments({})) == orientation::identity);
    auto no_tag = with_segments({app1(exif_payload({.include_orientation = false}))});
    TEST_ASSERT_TRUE(orientation_of(no_tag) == orientation::identity);
}

TEST_CASE("jpeg EXIF orientation is identity when out of range", "[idfxx][jpeg]") {
    for (uint16_t v : {0, 9, 0xFFFF}) {
        for (bool le : {true, false}) {
            auto data = with_segments({app1(exif_payload({.little_endian = le, .value = v}))});
            TEST_ASSERT_TRUE(orientation_of(data) == orientation::identity);
        }
    }
}

TEST_CASE("jpeg EXIF orientation is identity when the EXIF data is malformed", "[idfxx][jpeg]") {
    // Truncated within the TIFF header, the IFD entry count, and the
    // Orientation entry.
    for (size_t cut : {4, 9, 30}) {
        auto data = with_segments({app1(exif_payload({.value = 6, .truncate_to = cut}))});
        TEST_ASSERT_TRUE(orientation_of(data) == orientation::identity);
    }
    // IFD0 offset past the end of the data.
    auto bad_offset = with_segments({app1(exif_payload({.value = 6, .ifd_offset = 0x1000}))});
    TEST_ASSERT_TRUE(orientation_of(bad_offset) == orientation::identity);
    // Orientation stored as a LONG rather than a SHORT.
    auto bad_type = with_segments({app1(exif_payload({.value = 6, .type = 4}))});
    TEST_ASSERT_TRUE(orientation_of(bad_type) == orientation::identity);
    // Orientation with two values.
    auto bad_count = with_segments({app1(exif_payload({.value = 6, .count = 2}))});
    TEST_ASSERT_TRUE(orientation_of(bad_count) == orientation::identity);
    // Unknown byte order.
    auto bad_order = exif_payload({.value = 6});
    bad_order[6] = 'X';
    TEST_ASSERT_TRUE(orientation_of(with_segments({app1(bad_order)})) == orientation::identity);
    // IFD0 offset within the 8-byte TIFF header.
    for (uint32_t offset : {0, 2, 4, 7}) {
        auto in_header = with_segments({app1(exif_payload({.value = 6, .ifd_offset = offset}))});
        TEST_ASSERT_TRUE(orientation_of(in_header) == orientation::identity);
    }
}

TEST_CASE("jpeg EXIF orientation skips a preceding XMP segment", "[idfxx][jpeg]") {
    static const char xmp_ns[] = "http://ns.adobe.com/xap/1.0/";
    std::vector<uint8_t> xmp(xmp_ns, xmp_ns + sizeof(xmp_ns)); // including the NUL
    for (char c : std::string_view("<x:xmpmeta/>")) {
        xmp.push_back(static_cast<uint8_t>(c));
    }
    auto data = with_segments({app1(xmp), app1(exif_payload({.value = 6}))});
    TEST_ASSERT_TRUE(orientation_of(data) == orientation::rotate_90);

    // An APP1 segment shorter than the "Exif\0\0" prefix.
    data = with_segments({app1({'E', 'x'}), app1(exif_payload({.value = 6}))});
    TEST_ASSERT_TRUE(orientation_of(data) == orientation::rotate_90);

    // An APP1 length too small to count itself, which only the length is read of.
    data = with_segments({{0xFF, 0xE1, 0x00, 0x01}, app1(exif_payload({.value = 6}))});
    TEST_ASSERT_TRUE(orientation_of(data) == orientation::rotate_90);
}

TEST_CASE("jpeg EXIF orientation comes from the first Exif segment", "[idfxx][jpeg]") {
    auto data = with_segments({app1(exif_payload({.value = 6})), app1(exif_payload({.value = 8}))});
    TEST_ASSERT_TRUE(orientation_of(data) == orientation::rotate_90);

    // Even when the first is malformed.
    auto bad_order = exif_payload({.value = 6});
    bad_order[6] = 'X';
    data = with_segments({app1(bad_order), app1(exif_payload({.value = 8}))});
    TEST_ASSERT_TRUE(orientation_of(data) == orientation::identity);
}

TEST_CASE("jpeg APP1 segments don't count towards memory_limit", "[idfxx][jpeg]") {
    const size_t needed = smallest_limit(with_segments({}));

    // An Exif segment padded out to 60 KB, as a thumbnail would. APP1 segments are read past rather than kept. The
    // padding goes straight into the image: the test heap can't spare room for copies of it.
    constexpr size_t big_length = 60000;
    std::vector<uint8_t> data = with_segments({app1(exif_payload({.value = 6}))});
    const size_t at = marker_offset(data, 0xE1);
    const size_t length = (data[at + 2] << 8) | data[at + 3];
    data.reserve(data.size() + big_length - length);
    data.insert(data.begin() + at + 2 + length, big_length - length, 0);
    data[at + 2] = big_length >> 8;
    data[at + 3] = big_length & 0xFF;

    memory_source src{data};
    auto dec = jpeg::decoder::make(src, {.memory_limit = needed});
    TEST_ASSERT_TRUE(dec.has_value());
    TEST_ASSERT_TRUE(dec->info().orientation == orientation::rotate_90);
    image::buffer<> out(dec->output_width(), dec->output_height());
    TEST_ASSERT_TRUE(dec->try_decode(out).has_value());
}

TEST_CASE("jpeg EXIF orientation never fails the decode", "[idfxx][jpeg]") {
    auto data = with_segments({app1(exif_payload({.value = 8, .truncate_to = 9}))});
    memory_source src{data};
    auto dec = jpeg::decoder::make(src);
    TEST_ASSERT_TRUE(dec.has_value());
    image::buffer<> out(dec->output_width(), dec->output_height());
    TEST_ASSERT_TRUE(dec->try_decode(out).has_value());

    // Orientation is reported, not applied: the output keeps the stored size.
    auto rotated = with_segments({app1(exif_payload({.value = 6}))});
    memory_source rsrc{rotated};
    auto rdec = jpeg::decoder::make(rsrc);
    TEST_ASSERT_TRUE(rdec.has_value());
    TEST_ASSERT_TRUE(rdec->info().orientation == orientation::rotate_90);
    TEST_ASSERT_EQUAL_UINT32(16, rdec->output_width());
    TEST_ASSERT_EQUAL_UINT32(8, rdec->output_height());
}

// =============================================================================
// Exception-based API
// =============================================================================

#ifdef CONFIG_COMPILER_CXX_EXCEPTIONS

namespace {

class throwing_source {
public:
    result<size_t> try_read(std::span<uint8_t>) { throw std::runtime_error("source failed"); }
};

} // namespace

TEST_CASE("jpeg decoder constructor decodes into a buffer", "[idfxx][jpeg]") {
    memory_source src{bytes(img::scaled)};
    jpeg::decoder dec(src);
    TEST_ASSERT_EQUAL_UINT32(61, dec.info().width);
    dec.scale_to_cover(img::scaled_outputs[1].width, img::scaled_outputs[1].height);
    image::buffer<> out(dec.output_width(), dec.output_height());
    dec.decode(out);
    TEST_ASSERT_EQUAL_HEX32(img::scaled_outputs[1].hash, fnv1a(out));
}

TEST_CASE("jpeg decode delivers rows to a sink", "[idfxx][jpeg]") {
    memory_source src{bytes(img::baseline_444)};
    jpeg::decoder dec(src, {.memory_limit = std::nullopt});
    image::buffer<> out(dec.output_width(), dec.output_height());
    dec.decode([&](image::point at, image::view<const rgb888> row) -> result<void> {
        std::copy(row.row(0).begin(), row.row(0).end(), out.row(at.y).begin());
        return {};
    });
    TEST_ASSERT_EQUAL_HEX32(img::baseline_444_hash, fnv1a(out));
}

TEST_CASE("jpeg decoder constructor throws on unsupported data", "[idfxx][jpeg]") {
    memory_source src{bytes(img::cmyk)};
    bool threw = false;
    try {
        jpeg::decoder dec(src);
    } catch (const std::system_error& e) {
        threw = true;
        TEST_ASSERT_TRUE(e.code() == jpeg::errc::not_supported);
    }
    TEST_ASSERT_TRUE(threw);
}

TEST_CASE("jpeg decode throws on errors", "[idfxx][jpeg]") {
    std::span<const uint8_t> data = bytes(img::baseline_420);
    memory_source src{data.first(data.size() - 2)};
    jpeg::decoder dec(src);
    image::buffer<> out(dec.output_width(), dec.output_height());
    bool threw = false;
    try {
        dec.decode(out);
    } catch (const std::system_error& e) {
        threw = true;
        TEST_ASSERT_TRUE(e.code() == jpeg::errc::truncated);
    }
    TEST_ASSERT_TRUE(threw);

    threw = false;
    try {
        dec.decode(out);
    } catch (const std::system_error& e) {
        threw = true;
        TEST_ASSERT_TRUE(e.code() == idfxx::errc::invalid_state);
    }
    TEST_ASSERT_TRUE(threw);
}

TEST_CASE("jpeg decode throws the error a sink returns", "[idfxx][jpeg]") {
    memory_source src{bytes(img::baseline_420)};
    jpeg::decoder dec(src);
    const std::error_code stop = std::make_error_code(std::errc::operation_canceled);
    bool threw = false;
    try {
        dec.decode([&](image::point, image::view<const rgb888>) -> result<void> { return error(stop); });
    } catch (const std::system_error& e) {
        threw = true;
        TEST_ASSERT_TRUE(e.code() == stop);
    }
    TEST_ASSERT_TRUE(threw);
}

TEST_CASE("jpeg propagates an exception thrown by the byte source", "[idfxx][jpeg]") {
    throwing_source src;
    bool threw = false;
    try {
        auto dec = jpeg::decoder::make(src);
        (void)dec;
    } catch (const std::runtime_error& e) {
        threw = true;
        TEST_ASSERT_EQUAL_STRING("source failed", e.what());
    }
    TEST_ASSERT_TRUE(threw);
}

#endif // CONFIG_COMPILER_CXX_EXCEPTIONS
