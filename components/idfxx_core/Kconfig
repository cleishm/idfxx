## components/idfxx_core/Kconfig
```kconfig
menu "IDFXX"
    config IDFXX_STD_FORMAT
        bool "Enable std::format support"
        default y
        help
            Enable std::formatter specializations for idfxx types.
            Disable to reduce image size when formatting is not needed.
endmenu
```

## components/idfxx_http_client/examples/http_get/sdkconfig.defaults
```kconfig
CONFIG_COMPILER_CXX_EXCEPTIONS=y
CONFIG_COMPILER_CXX_RTTI=y
CONFIG_COMPILER_CXX_STD_23=y
CONFIG_ESPTOOLPY_FLASHSIZE_4MB=y
CONFIG_PARTITION_TABLE_SINGLE_APP_LARGE=y
CONFIG_MBEDTLS_CERTIFICATE_BUNDLE=y
CONFIG_MBEDTLS_CERTIFICATE_BUNDLE_DEFAULT_FULL=y
```

## components/idfxx_ota/examples/ota_info/sdkconfig.defaults
```kconfig
CONFIG_COMPILER_CXX_EXCEPTIONS=y
CONFIG_COMPILER_CXX_RTTI=y
CONFIG_COMPILER_CXX_STD_23=y
CONFIG_ESPTOOLPY_FLASHSIZE_4MB=y
CONFIG_PARTITION_TABLE_TWO_OTA=y
```

## sdkconfig.defaults
```kconfig
CONFIG_COMPILER_CXX_EXCEPTIONS=y
CONFIG_COMPILER_CXX_RTTI=y
CONFIG_COMPILER_CXX_STD_23=y
CONFIG_ESP_TIMER_SUPPORTS_ISR_DISPATCH_METHOD=y
CONFIG_PARTITION_TABLE_CUSTOM=y
CONFIG_PARTITION_TABLE_CUSTOM_FILENAME="partitions.csv"
CONFIG_PARTITION_TABLE_FILENAME="partitions.csv"
CONFIG_ESPTOOLPY_FLASHSIZE_4MB=y
CONFIG_ESP_SYSTEM_PANIC_PRINT_HALT=y
CONFIG_ESP_MAIN_TASK_STACK_SIZE=16384
```

## sdkconfig.defaults.esp32c5
```kconfig
# Target-specific overrides for esp32c5.
# The Wi-Fi 6 (HE) stack on esp32c5 pushes the test app over the 1.875MB OTA
# slots used by partitions.csv, so switch to an 8MB flash layout with 3.875MB
# OTA partitions. Matches the esp32c6 configuration; adjust if your module has 4MB flash.
CONFIG_ESPTOOLPY_FLASHSIZE_4MB=n
CONFIG_ESPTOOLPY_FLASHSIZE_8MB=y
CONFIG_PARTITION_TABLE_CUSTOM_FILENAME="partitions_8mb.csv"
CONFIG_PARTITION_TABLE_FILENAME="partitions_8mb.csv"
```

## sdkconfig.defaults.esp32c6
```kconfig
# Target-specific overrides for esp32c6.
# The Wi-Fi 6 (HE) stack on esp32c6 pushes the test app over the 1.875MB OTA
# slots used by partitions.csv, so switch to an 8MB flash layout with 3.875MB
# OTA partitions. esp32-c6-devkitc-1 ships with 8MB flash by default.
CONFIG_ESPTOOLPY_FLASHSIZE_4MB=n
CONFIG_ESPTOOLPY_FLASHSIZE_8MB=y
CONFIG_PARTITION_TABLE_CUSTOM_FILENAME="partitions_8mb.csv"
CONFIG_PARTITION_TABLE_FILENAME="partitions_8mb.csv"
```
