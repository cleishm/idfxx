## components/core/idfxx_log/Kconfig
```kconfig
menu "IDFXX log"
    depends on IDFXX_STD_FORMAT

    config IDFXX_LOG_MAX_SINKS
        int "Maximum number of sinks"
        default 4
        range 1 16
        help
            The maximum number of sinks (idfxx::log::sink) that can be added with
            idfxx::log::add_sink at the same time. The count includes sinks added for every line,
            and sinks that are being removed until the calls into them have finished. Adding a
            sink beyond this limit fails with errc::invalid_state.

    config IDFXX_LOG_ALL_LINES
        bool "Let sinks receive every log line"
        default n
        help
            With this option enabled, a sink can receive every ESP-IDF log line: lines logged with
            ESP_LOGx, ESP_LOG_BUFFER_* and esp_log_write, and by the libraries that log through
            them. Add such a sink with idfxx::log::add_sink(idfxx::log::all_lines, sink).

            To receive every line, idfxx_log wraps esp_log and esp_log_va at link time
            (-Wl,--wrap). The app and its other components must not wrap them as well: a second
            definition of __wrap_esp_log or __wrap_esp_log_va makes the link fail.

            Sinks do not receive early, DRAM or binary-mode lines, or lines more verbose than the
            compile-time maximum level. With LOG_MASTER_LEVEL under log v1, they also do not
            receive ESP_LOGx lines more verbose than the master level, because the macros skip
            those lines before logging them.

            While no such sink is added, each log call makes one extra check and uses about 64
            bytes more stack, for the wrapper's own frame. For the stack that a log call uses
            while such a sink is added, see IDFXX_LOG_SINK_MAX_LINE.

            With this option disabled, sinks receive only the lines logged through idfxx::log,
            nothing is wrapped, and idfxx::log::all_lines is not defined.

    config IDFXX_LOG_SINK_MAX_LINE
        int "Maximum length of an ESP-IDF log line passed to a sink (bytes)"
        depends on IDFXX_LOG_ALL_LINES
        default 256
        range 64 1024
        help
            The maximum length of a line logged through ESP-IDF's log that is passed to a sink
            added with idfxx::log::all_lines. Lines logged through idfxx::log are not limited. A
            longer line is shortened to this limit, at a UTF-8 character boundary.

            The limit includes the prefix that the line's caller formatted before the message,
            even though the sink does not receive the prefix. The prefix is log v1's level,
            timestamp and tag, or whatever a caller of esp_log_write formats itself. For a line
            logged in several calls, the limit also includes the line's tag, which is the tag of
            its first call.

            Each join slot (IDFXX_LOG_JOIN_SLOTS) holds a line of this size. For a line logged in
            several calls, each call copies the line so far, up to this many bytes, with
            interrupts disabled. A large limit therefore adds interrupt latency.

            While such a sink is added, a log call uses up to about this limit plus 64 bytes more
            stack than with IDFXX_LOG_ALL_LINES disabled, plus the stack that the sinks themselves
            use. This was measured on esp32s3 in QEMU with ESP-IDF's console output. The line is
            formatted for the sinks after the console has printed it, not while it prints. If
            printing uses less stack (no console, or a lighter vprintf), a log call therefore
            still uses about as much stack as it does with ESP-IDF's console.

            ESP-IDF's own tasks that have small stacks may need larger ones if they log while such
            a sink is added. One example is the system event task (sys_evt), which has 2304 bytes
            by default (CONFIG_ESP_SYSTEM_EVENT_TASK_STACK_SIZE).

    config IDFXX_LOG_JOIN_SLOTS
        int "Maximum number of tasks with an unfinished line"
        depends on IDFXX_LOG_ALL_LINES
        default 4
        range 1 32
        help
            Some libraries log one line in several calls. For example, the Wi-Fi libraries log a
            prefix, then the message, then a newline. Each task with an unfinished line holds a
            slot until the line's newline arrives. The line is then passed to the sinks with the
            level and tag of its first call.

            When every slot is in use and another task starts a line, that task takes the slot of
            the task that used its slot least recently, and the unfinished line in that slot is
            discarded. The unfinished line of a deleted task is also discarded. Each slot holds a
            line of up to IDFXX_LOG_SINK_MAX_LINE bytes. See that option for the effect on
            interrupt latency.
endmenu
```

## components/system/idfxx_persistent_log/Kconfig
```kconfig
menu "IDFXX persistent log"
    config IDFXX_PERSISTENT_LOG_CAPTURE_ALL_LINES
        bool "Capture every ESP-IDF log line"
        depends on IDFXX_STD_FORMAT
        default y
        select IDFXX_LOG_ALL_LINES
        help
            Lets the log capture ESP-IDF's log lines as well as the lines logged through
            idfxx::log. ESP-IDF's log lines are the lines logged with ESP_LOGx and esp_log_write,
            and by the libraries and other idfxx components that log through ESP-IDF's log.
            config::capture selects which lines are stored.

            With this option enabled, capture is an idfxx::log sink added with
            idfxx::log::all_lines, so this option also enables idfxx_log's IDFXX_LOG_ALL_LINES.
            That option wraps esp_log and esp_log_va at link time, so nothing else in the app may
            wrap them. Its help text describes which lines sinks never receive, and how the option
            affects stack use.

            With this option disabled, capture stores only the lines logged through idfxx::log,
            and nothing is wrapped.

            Capture's levels use idfxx_log's idfxx::log::level type, so capture needs std::format
            support (IDFXX_STD_FORMAT). Without std::format support, capture is off. The log then
            stores only the lines that the app passes to persistent_log::append(), and
            config::capture is not defined.

    config IDFXX_PERSISTENT_LOG_RTC_RING_SIZE
        int "RTC ring size (bytes)"
        default 2048
        range 512 65536
        help
            The size of the ring buffer in RTC memory (the RTC ring) that holds the log's lines
            until they are written to flash. The RTC ring survives deep sleep and any reset other
            than a power cut. After a firmware update that changes this size, start discards the
            lines that the ring holds. When more lines are waiting than the ring can hold, the
            oldest lines are dropped. The next flush then writes a line that says how many bytes
            were dropped. A flush copies the ring's pending bytes through a buffer of the same size
            in internal RAM. Each reader of the log's entries allocates a buffer on the heap whose
            size is this size plus the size of the longest entry.

            The ring must hold at least 73 + MAX_LINE + MAX_LINE / 2 bytes, where MAX_LINE is
            IDFXX_PERSISTENT_LOG_MAX_LINE, or the build fails. That is the size of the longest
            entry: the stamp, the text, a tab for each line after the first, and the newline.

            The ring must also fit in the target's RTC memory, together with everything else
            stored there, or linking fails. RTC memory is 8 KiB on esp32, esp32s2, esp32s3 and
            esp32c3, 16 KiB on esp32c6 and 4 KiB on esp32h2, minus what the bootloader and the ULP
            coprocessor reserve.

    config IDFXX_PERSISTENT_LOG_MAX_LINE
        int "Maximum length of a log entry (bytes)"
        default 256
        range 64 1024
        help
            The maximum length of an entry, not counting its stamp or the tabs that start its
            later lines. For a captured line, the entry is the line's level and tag ("L tag: ")
            followed by its message. For persistent_log::append(), the entry is the text of one
            call. A longer entry is shortened to this limit, at a UTF-8 character boundary.

            A line captured from ESP-IDF's log (with IDFXX_PERSISTENT_LOG_CAPTURE_ALL_LINES) may
            already have been shortened by idfxx_log (see IDFXX_LOG_SINK_MAX_LINE). Lines logged
            through idfxx::log are passed complete. The RTC ring must be large enough for the
            longest entry (see IDFXX_PERSISTENT_LOG_RTC_RING_SIZE).

            While capture is on, each task that logs uses stack for capture:
            - With IDFXX_PERSISTENT_LOG_CAPTURE_ALL_LINES enabled, the task uses the stack that
              IDFXX_LOG_SINK_MAX_LINE's help gives for a sink added with all_lines, plus up to
              about 768 bytes more for capture itself.
            - With IDFXX_PERSISTENT_LOG_CAPTURE_ALL_LINES disabled, the task uses up to about
              768 bytes more than it uses to log the line through idfxx::log without capture.
            Both figures were measured on esp32s3 in QEMU.

    config IDFXX_PERSISTENT_LOG_SUPPRESSED_FAULTS
        int "Maximum number of suppressed fault kinds"
        default 8
        range 1 32
        help
            The maximum number of fault kinds with suppressed repeats that RTC memory holds at the
            same time. RTC memory holds these kinds so that a repeat of a suppressed fault is not
            recorded again.
endmenu
```
